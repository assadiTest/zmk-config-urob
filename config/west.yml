## config/west.yml
```yaml
manifest:
  remotes:
    - name: ftc
      url-base: https://github.com/ftc/
    - name: zmkfirmware
      url-base: https://github.com/zmkfirmware
    - name: urob
      url-base: https://github.com/urob
  projects:
    - name: zmk
      remote: urob
      revision: main
      #revision: mouse-ftc
      import: app/west.yml
  self:
    path: config
```
